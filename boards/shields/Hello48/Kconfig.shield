## boards/shields/Hello48/Kconfig.shield
```kconfig
# No whitespace after the comma or in the keyboard name!
config SHIELD_HELLO48
    def_bool $(shields_list_contains,Hello48)

#config SHIELD_HELLO48_DONGLE
#    def_bool $(shields_list_contains,Hello48_dongle)
```

## boards/shields/hello48/Kconfig.shield
```kconfig
# No whitespace after the comma or in the keyboard name!
config SHIELD_HELLO48
    def_bool $(shields_list_contains,hello48)

config SHIELD_HELLO48_DONGLE
    def_bool $(shields_list_contains,hello48_dongle)
```
